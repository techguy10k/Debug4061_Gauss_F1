#include "LCD.h"
#include "User_Font.h"

const uint8_t NumberTable8_8[];
extern const unsigned char asc2_1206[95][12];
extern const unsigned char asc2_1608[95][16];
extern const unsigned char asc2_2412[95][36];
uint8_t gram[192][8]={0};
void LCD_WriteCommand(uint8_t Command)
{
  HAL_GPIO_WritePin(LCD_CS_GPIO_Port,LCD_CS_Pin,GPIO_PIN_RESET);
  HAL_GPIO_WritePin(LCD_RS_GPIO_Port,LCD_RS_Pin,GPIO_PIN_RESET);
  HAL_SPI_Transmit(&hspi1,&Command,1,10);
  HAL_GPIO_WritePin(LCD_CS_GPIO_Port,LCD_CS_Pin,GPIO_PIN_SET);
}

void LCD_WriteDdata(uint8_t Data)
{
  HAL_GPIO_WritePin(LCD_CS_GPIO_Port,LCD_CS_Pin,GPIO_PIN_RESET);
  HAL_GPIO_WritePin(LCD_RS_GPIO_Port,LCD_RS_Pin,GPIO_PIN_SET);
  HAL_SPI_Transmit(&hspi1,&Data,1,100);
  HAL_GPIO_WritePin(LCD_CS_GPIO_Port,LCD_CS_Pin,GPIO_PIN_SET);
}


/* 写一定长度字符 */
void LCD_WriteLine(uint8_t* data,uint16_t size,uint8_t PosY,uint8_t PosX)
{	
	LCD_SetPointerPositon(PosY,PosX);
	for(uint8_t counter = 0;counter < size * 4 ;counter ++)
	{
		LCD_WriteDdata(data[counter]);
//		PosX += 4;
//		LCD_SetColumnAddress(PosX);
	}
}

void LCD_WriteLine16(uint8_t* data,uint16_t size,uint8_t PosY,uint8_t PosX)
{
	
}


/* 设置列地址 */
void LCD_SetColumnAddress(uint8_t ColumnAddress)
{
	/* 写列地址低4位 */
	LCD_WriteCommand(0x00 | (ColumnAddress & 0x0f));
	/* 写列地址高4位 */
	LCD_WriteCommand(0x10 | ((ColumnAddress & 0xf0) >> 4));
}

/* 设置页地址 */
void LCD_SetPageAddress(uint8_t PageAddress)
{
	LCD_WriteCommand(0xb0 | (PageAddress & 0x0f));
}

/* 设置LCD数据指针位置 */
void LCD_SetPointerPositon(uint8_t PageAddress,uint8_t ColumnAddress)
{
	LCD_SetColumnAddress(ColumnAddress);
	LCD_SetPageAddress(PageAddress);
}


/* LCD刷新所有像素 */
void LCD_UpdateAllPixel(uint8_t* Address)
{
	LCD_SetPointerPositon(0,0);
	
	for(uint16_t counter = 0;counter < 1536;counter ++)
	{
		LCD_WriteDdata(Address[counter]);
	}
	
	
} 
void LCD_ShowChar(uint8_t x,uint8_t y,uint8_t chr,uint8_t size)
{      			    
	uint8_t temp,t,t1;
	uint8_t y0=y;
	uint8_t csize=(size/8+((size%8)?1:0))*(size/2);		//得到字体一个字符对应点阵集所占的字节数
	chr=chr-' ';//得到偏移后的值		 
    for(t=0;t<csize;t++)
    {   
		if(size==12)temp=asc2_1206[chr][t]; 	 	//调用1206字体
		else if(size==16)temp=asc2_1608[chr][t];	//调用1608字体
		else if(size==24)temp=asc2_2412[chr][t];	//调用2412字体
		else return;								//没有的字库
        for(t1=0;t1<8;t1++)
		{
			if(temp&0x80)
				LCD_DrawPoint(x,y,1);
				//continue;
//			else
//			LCD_DrawPoint(x,y,1);
			temp<<=1;
			y++;
			if((y-y0)==size)
			{
				y=y0;
				x++;
				break;
			}
		}  	 
    }          
}
void LCD_DrawPoint(uint8_t x,uint8_t y,uint16_t mode)
{
	int t1=0,t2=0;
	uint8_t m=0x01,m1;
	uint8_t n=0xfe,n1;
	LCD_SetPointerPositon(0,0);
	LCD_SetColumnAddress(x);
	t1=y/8;
	t2=y%8;
	if(t2!=0)
	{
		//t1++;
	}
	//t2=8-t2;
	if(mode==1)
	{
	m1=m<<t2;
	LCD_SetPageAddress(t1);
	gram[x][t1]|=m1;
	}
	else if(mode == 0)
	{
		n1=n<<t2;
		LCD_SetPageAddress(t1);
		gram[x][t1]&=n1;
	}
	//LCD_SetPointerPositon(0,0);
	LCD_WriteDdata(gram[x][t1]);
	
	
////	LCD_SetPageAddress(y);
//	LCD_WriteDdata(0x01);
//	LCD_SetPointerPositon(0,0);
//	LCD_WriteDdata(0x03);
//	int t,t1,t2,x1,x2;
//	uint8_t m=0x01,m1;
//	t=(int)x*(int)y;
//	
//	t1=t/8;
//	t2=t%8;
//	
//	x1=t1/192;
//	x2=t1%192;
//	
//	m1=m<<t2;
//	if(x2!=0)
//	{
//		x1++;
//	}
//	LCD_SetColumnAddress(x2);
//	LCD_SetPageAddress(x1);
//	LCD_WriteDdata(m1);
	
}
void LCD_ShowString(u16 x,u16 y,u16 width,u16 height,u8 size,u8 *p)
{         
	u8 x0=x;
	width+=x;
	height+=y;
    while((*p<='~')&&(*p>=' '))
    {       
        if(x>=width){x=x0;y+=size;}
        if(y>=height)break;
        LCD_ShowChar(x,y,*p,size);
        x+=size/2;
        p++;
    }  
}
void LCD_Init(void)
{
  /* LCD复位电平要求 RST低电平有效 至少1ms */
  /* 拉低片选 */
  HAL_GPIO_WritePin(LCD_CS_GPIO_Port,LCD_CS_Pin,GPIO_PIN_RESET);
  HAL_GPIO_WritePin(LCD_RST_GPIO_Port,LCD_RST_Pin,GPIO_PIN_RESET);
  HAL_Delay(50);
  HAL_GPIO_WritePin(LCD_RST_GPIO_Port,LCD_RST_Pin,GPIO_PIN_SET);
  HAL_GPIO_WritePin(LCD_CS_GPIO_Port,LCD_CS_Pin,GPIO_PIN_SET);
	HAL_Delay(50);
  /* 上电复位结束 */
	
	/* 上电显示屏设置相关 */
  LCD_WriteCommand(0xe2); //软件复位
  HAL_Delay(50);           
  LCD_WriteCommand(0x2f); //开启内部升压电路
  HAL_Delay(50);
  LCD_WriteCommand(0xa3); //不知道是什么作用 再尝试(设置帧率?)
  LCD_WriteCommand(0x81); //微调对比度
  LCD_WriteCommand(0x80); //微调对比度值
  LCD_WriteCommand(0xeb); // 1/9偏压 不知道有啥用
  LCD_WriteCommand(0xc4); //行列扫描顺序 从上到下
	
	//LCD_WriteCommand(0xaf); //刷新完屏幕再 避免上电随机数导致乱码 打开显示使能
	

	/* 让屏幕全白 */
	LCD_SetPointerPositon(0,0);
	for(uint16_t Counter = 0;Counter < 1536;Counter ++)
	{
		LCD_WriteDdata(0x00);
	} 
	LCD_SetPointerPositon(0,0);
	
	LCD_WriteCommand(0xaf); //刷新完屏幕再 避免上电随机数导致乱码 打开显示使能
	
	HAL_Delay(50);
	
	
	
	
}


void LCD_Clear(void)
{
	/* 让屏幕全白 */
	LCD_SetPointerPositon(0,0);
	for(uint16_t Counter = 0;Counter < 1536;Counter ++)
	{
		LCD_WriteDdata(0x00);
		
	} 
	for(int i=0;i<192;i++)
	{
	for(int j=0;j<8;j++)
		{
			gram[i][j]=0;
		}
	}
	LCD_SetPointerPositon(0,0);
}


void LCD_Display8_8Number(uint8_t number)
{
	number *= 4;
	
	LCD_WriteDdata(NumberTable8_8[number]);
	LCD_WriteDdata(NumberTable8_8[number + 1]);
	LCD_WriteDdata(NumberTable8_8[number + 2]);
	LCD_WriteDdata(NumberTable8_8[number + 3]);
}


/* 打印8*8 正号 + */
void LCD_Display_Positive(void)
{
	uint8_t table[] ={0x08,0x08,0x3E,0x08/*"+",0*/};
	
	LCD_WriteDdata(table[0]);
	LCD_WriteDdata(table[1]);
	LCD_WriteDdata(table[2]);
	LCD_WriteDdata(table[3]);
	
}

/* 打印8*8 负号 - */
void LCD_Display_Negative(void)
{
	uint8_t table[] ={0x08,0x08,0x08,0x00/*"-",0*/};
	
	LCD_WriteDdata(table[0]);
	LCD_WriteDdata(table[1]);
	LCD_WriteDdata(table[2]);
	LCD_WriteDdata(table[3]);	
}

/* 启动页面 英伟达 */
const uint8_t LCDtable_NVIDIA[8][192] = {
{0x00,0x00,0x00,0x00,0x00,0x00,0x00,0x00,0x00,0x00,0x00,0x00,0x00,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0x00,0x00},
{0x00,0x00,0x00,0x00,0x00,0x00,0x00,0x00,0x00,0x00,0x00,0x00,0x00,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0x00,0x00},
{0x00,0x00,0x00,0x00,0x00,0x00,0x00,0x00,0x00,0x00,0x00,0x00,0x00,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0x00,0x00},
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{0x00,0x00,0x00,0x00,0x00,0x00,0x00,0x00,0x00,0x00,0x00,0x00,0x00,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0x00,0x00}
};

/* 8*16像素阿拉伯数字表 */
const uint8_t NumberTable16_8[] = 
{
0x00,0xE0,0x10,0x08,0x08,0x10,0xE0,0x00,
0x00,0x0F,0x10,0x20,0x20,0x10,0x0F,0x00,/*0*/
0x00,0x10,0x10,0xF8,0x00,0x00,0x00,0x00,
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0x00,0x00,0x31,0x22,0x22,0x11,0x0F,0x00/*9*/
};


/* 8*8像素 阿拉伯数字表 */
const uint8_t NumberTable8_8[] = 
{
0x38,0x44,0x38,0x00,/*"0",0*/
0x00,0x48,0x78,0x40,/*"1",1*/
0x6C,0x54,0x4C,0x00,/*"2",2*/
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0x1C,0x54,0x3C,0x00/*"9",9*/
};

/* 基础要求 1 显示 */
const uint8_t Basic1Table[] = 
{
0x00,0x7C,0x48,0x78,/*b*/
0x68,0x58,0x78,0x40,/*a*/
0x00,0x58,0x68,0x68,/*s*/
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0x00,0x70,0x58,0x58/*e*/
};

/* 基础要求 1 任意按键开火 */
const uint8_t Basic1FireTable[] =
{
0x00,0x7C,0x14,0x1C,/*"P",0*/
0x48,0x78,0x48,0x08,/*"r",1*/
0x00,0x70,0x58,0x58,/*"e",2*/
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0x00,0x70,0x58,0x58/*"e",20*/
};

/* 基础要求 2 显示 */
const uint8_t Basic2Table[] = 
{
0x00,0x7C,0x48,0x78,/*b*/
0x68,0x58,0x78,0x40,/*a*/
0x00,0x58,0x68,0x68,/*s*/
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0x08,0x7C,0x40,0x00/*t*/
};

/* 基础要求2 输入准备 */
const uint8_t Basic2PleaseInputTable[] =
{
0x00,0x7C,0x14,0x1C,/*"P",0*/
0x00,0x44,0x7C,0x40,/*"l",1*/
0x00,0x70,0x58,0x58,/*"e",2*/
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0x08,0x7C,0x40,0x00/*"t",29*/
};


/* 基础要求2 距离显示 */
const uint8_t Basic2DistantDisplay[] = 
{
0x00,0x7C,0x44,0x38,/*"D",0*/
0x00,0x48,0x7C,0x40,/*"i",1*/
0x00,0x58,0x68,0x68,/*"s",2*/
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0x00,0x00,0x00,0x00/*" ",9*/
};


/* 基础要求 3 显示 */
const uint8_t Basic3Table[] = 
{
0x00,0x7C,0x48,0x78,/*b*/
0x68,0x58,0x78,0x40,/*a*/
0x00,0x58,0x68,0x68,/*s*/
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0x00,0x70,0x58,0x58/*e*/
};

/* 基础要求 3 提示输入角度 */
const uint8_t Basic3InputAngleTable[] =
{
	
0x00,0x7C,0x14,0x1C,/*"P",0*/
0x00,0x44,0x7C,0x40,/*"l",1*/
0x00,0x70,0x58,0x58,/*"e",2*/
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0x00,0x00,0x00,0x00/*" ",19*/
};

/* 基础要求 3 提示输入距离 */
const uint8_t Basic3InputDistantTable[] =
{
0x00,0x7C,0x14,0x1C,/*"P",0*/
0x00,0x44,0x7C,0x40,/*"l",1*/
0x00,0x70,0x58,0x58,/*"e",2*/
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0x00,0x00,0x00,0x00/*" ",21*/
};

/* 提高要求1 搜寻并自动射击 */
const uint8_t Advance1Table[] =
{
0x68,0x58,0x78,0x40,/*a*/
0x78,0x48,0x7C,0x00,/*d*/
0x08,0x38,0x40,0x38,/*v*/
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0x00,0x70,0x58,0x58/*e*/
};


/* 提高要求2 运动射击 */
const uint8_t Advance2Table[] =
{
0x68,0x58,0x78,0x40,/*a*/
0x78,0x48,0x7C,0x00,/*d*/
0x08,0x38,0x40,0x38,/*v*/
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0x08,0x7C,0x40,0x00/*t*/
};

/* 模式选择页 */
const uint8_t ModeSetTable[] =
{
0x00,0x7C,0x14,0x1C,/*"P",0*/
0x00,0x44,0x7C,0x40,/*"l",1*/
0x00,0x70,0x58,0x58,/*"e",2*/
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0x00,0x00,0x48,0x00/*":",19*/
};


